## build/configs/arm/at91sam9263_defconfig
```kconfig
# AT91SAM9261 Platform Configuration

CONFIG_AT91SAM9263=y
CONFIG_AT91=y
CONFIG_ARCH=arm
CONFIG_ARCH_VER=armv5te
CONFIG_START_MEM=0x00300000

CONFIG_CROSS_COMPILE=arm-none-eabi-

# OS boot
CONFIG_LOADER_MENU=y
CONFIG_DEFAULT_LOADER=LM_NAND
CONFIG_OS_START_MEM=0x23F00000
CONFIG_OS_NAND_START = 0

# NAND
CONFIG_FLASH=y
CONFIG_NAND=y
CONFIG_NAND_AT91=y

# MMC/SD
CONFIG_MMC=y
CONFIG_MMC_AT91=y

# UART
CONFIG_UART=y
CONFIG_UART_AT91=y
CONFIG_UART_INDEX=0
CONFIG_YMODEM_SUPPORT=y
CONFIG_KERMIT_SUPPORT=y
```

## build/configs/arm/omap3_defconfig
```kconfig
# OMAP3 Platform Configuration

CONFIG_OMAP3 = y
CONFIG_PLAT = omap3
CONFIG_ARCH = arm
CONFIG_ARCH_VER = armv7-a
CONFIG_START_MEM = 0x402007F8

# Compile
CONFIG_VERBOSE = y
CONFIG_CROSS_COMPILE = arm-none-eabi-

# OS boot
CONFIG_LOADER_MENU = y
CONFIG_DEFAULT_LOADER = LM_NAND
CONFIG_OS_START_MEM = 0x83000000
CONFIG_OS_NAND_START = 0x20000

# MMC/SD
# CONFIG_MMC = y
# CONFIG_MMC_OMAP3 = y

# Flash
CONFIG_FLASH = y
CONFIG_NAND = y
CONFIG_NAND_OMAP3 = y
#CONFIG_NOR = y

# UART
CONFIG_UART_OMAP3 = y
CONFIG_UART_INDEX = 2
CONFIG_YMODEM = y
CONFIG_KERMIT = y

# SPI
#CONFIG_SPI = y
#CONFIG_SPI_OMAP3 = y
```

## build/configs/arm/omap4_defconfig
```kconfig
# OMAP4 Panda Board Configuration

# Basic Definition
CONFIG_OMAP4=y
CONFIG_BOARD_PANDA=y
CONFIG_ARCH=arm
CONFIG_ARCH_VER=armv7-a
CONFIG_START_MEM = 0x40304348

# Compiling
CONFIG_DEBUG=y
CONFIG_CROSS_COMPILE=arm-none-eabi-

# UART
CONFIG_UART_OMAP4=y
CONFIG_UART_INDEX=2
# UART Loader
CONFIG_YMODEM_SUPPORT=y
CONFIG_KERMIT_SUPPORT=y

# MMC/SD
# CONFIG_MMC=y
# CONFIG_MMC_OMAP4=y

# Flash
CONFIG_FLASH=y
CONFIG_NAND=y
CONFIG_NAND_OMAP4=y
CONFIG_OS_NAND_START = 0x20000
#CONFIG_NOR=y

# OS boot
CONFIG_OS_START_MEM=0x83000000
CONFIG_LOADER_MENU=y
CONFIG_DEFAULT_LOADER=LM_NAND
```

## build/configs/arm/s3c2440_defconfig
```kconfig
# S3C2410

CONFIG_S3C2440 = y
CONFIG_PLAT_DIR = s3c24x
CONFIG_ARCH = arm
CONFIG_ARCH_VER = armv4t
CONFIG_START_MEM = 0x00000000

# OS boot
CONFIG_LOADER_MENU = y
CONFIG_DEFAULT_LOADER = LM_NAND
CONFIG_OS_START_MEM = 0x33F80000
CONFIG_OS_NAND_START = 0x20000

# UART
CONFIG_UART = y
CONFIG_UART_S3C24X = y
CONFIG_UART_INDEX = 0
CONFIG_YMODEM_SUPPORT = y
# CONFIG_KERMIT_SUPPORT = y

# Flash
CONFIG_FLASH = y
CONFIG_NAND = y
CONFIG_NAND_S3C24X = y

# Compile
# CONFIG_VERBOSE
CONFIG_CROSS_COMPILE = arm-none-eabi-
```

## build/configs/arm/s3c6410_defconfig
```kconfig
# S3C6410 Platform Configuration

CONFIG_S3C6410 = y
CONFIG_PLAT = s3c64x
CONFIG_ARCH = arm
CONFIG_ARCH_VER = armv6k
CONFIG_START_MEM = 0x0C000000

CONFIG_CROSS_COMPILE = arm-none-eabi-

# OS boot
CONFIG_LOADER_MENU = y
CONFIG_DEFAULT_LOADER = LM_NAND
CONFIG_OS_START_MEM = 0x53000000
CONFIG_OS_NAND_START = 0x20000

# Flash
CONFIG_FLASH = y
CONFIG_NAND = y
CONFIG_NAND_S3C24X = y
CONFIG_NOR = y

# UART
CONFIG_UART = y
CONFIG_UART_S3C64X = y
CONFIG_UART_INDEX = 0
CONFIG_YMODEM = y
CONFIG_KERMIT = y

# MMC/SD
CONFIG_MMC = y
CONFIG_MMC_S3C64X = y

# SPI
CONFIG_SPI = y
CONFIG_SPI_S3C64X = y
```

## build/configs/armvirt_defconfig
```kconfig
# Qemu ARM virt platform configuration

CONFIG_ARCH = arm
CONFIG_PLAT = armvirt
CONFIG_ARCH_VER = armv7-a

CONFIG_DEBUG = y
CONFIG_VERBOSE = y

CONFIG_UART = y
CONFIG_PL011_UART = y

CONFIG_LOADER_MENU = y
CONFIG_YMODEM = y
CONFIG_KERMIT = y
CONFIG_OS_RAM_ADDR = 0x40200000
```

## build/configs/e310_defconfig
```kconfig
CONFIG_ARCH = risc-v
CONFIG_ARCH_VER = rv32imac
CONFIG_PLAT = e310

CONFIG_GPIO_LED = 5

CONFIG_UART = y
CONFIG_E310_UART = y
CONFIG_DEFAULT_LOADER = LM_NAND

CONFIG_DEBUG = y
CONFIG_CROSS_COMPILE = riscv64-unknown-elf-
```

## build/configs/evm3530_defconfig
```kconfig
# OMAP3 Platform Configuration

CONFIG_OMAP3 = y
CONFIG_PLAT = omap3
CONFIG_ARCH = arm
CONFIG_ARCH_VER = armv7-a

# Compile
CONFIG_VERBOSE = y
CONFIG_CROSS_COMPILE = arm-none-eabi-

# OS boot
CONFIG_LOADER_MENU = y
CONFIG_DEFAULT_LOADER = LM_NAND
CONFIG_OS_RAM_ADDR = 0x83000000
CONFIG_OS_NAND_START = 0x20000

# MMC/SD
# CONFIG_MMC = y
# CONFIG_MMC_OMAP3 = y

# Flash
CONFIG_FLASH = y
CONFIG_NAND = y
CONFIG_NAND_OMAP3 = y
#CONFIG_NOR = y

# UART
CONFIG_UART = y
CONFIG_UART_OMAP3 = y
CONFIG_UART_INDEX = 0
CONFIG_YMODEM = y
CONFIG_KERMIT = y

# SPI
#CONFIG_SPI = y
#CONFIG_SPI_OMAP3 = y
```

## build/configs/k210_defconfig
```kconfig
CONFIG_ARCH = risc-v
CONFIG_ARCH_VER = rv32imac
CONFIG_PLAT = k210

CONFIG_K210_UART = y

CONFIG_CROSS_COMPILE = riscv-none-embed-
```

## build/configs/omap4_defconfig
```kconfig
# OMAP4 Panda Board Configuration

# Basic Definition
CONFIG_OMAP4 = y
CONFIG_PLAT = omap4
CONFIG_ARCH = arm
CONFIG_ARCH_VER = armv7-a

# Compiling
CONFIG_VERBOSE = y
CONFIG_CROSS_COMPILE = arm-none-eabi-

# UART
CONFIG_UART = y
CONFIG_UART_OMAP4 = y
CONFIG_UART_INDEX = 2

# UART Loader
CONFIG_YMODEM = y
CONFIG_KERMIT = y

# MMC/SD
# CONFIG_MMC = y
# CONFIG_MMC_OMAP4 = y

# Flash
CONFIG_FLASH = y
CONFIG_NAND = y
CONFIG_NAND_OMAP4 = y
CONFIG_OS_NAND_START = 0x20000
#CONFIG_NOR = y

# OS boot
CONFIG_OS_RAM_ADDR = 0x83000000
CONFIG_LOADER_MENU = y
CONFIG_DEFAULT_LOADER = LM_NAND
```

## build/configs/wujian100_defconfig
```kconfig
CONFIG_ARCH = risc-v
CONFIG_ARCH_VER = rv32imac
CONFIG_PLAT = wujian100

CONFIG_WUJIAN100_UART = y

CONFIG_CROSS_COMPILE = riscv-none-embed-
```
